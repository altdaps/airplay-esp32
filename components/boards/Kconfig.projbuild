## components/boards/Kconfig.projbuild
```kconfig
menu "Board Configuration"
    choice BOARD_TARGET
        prompt "Select Target Board"
        default BOARD_ESP32_GENERIC if IDF_TARGET_ESP32
        default BOARD_ESP32S3_GENERIC if IDF_TARGET_ESP32S3

        config BOARD_SQUEEZEAMP
            bool "SqueezeAMP (8MB flash)"
            depends on IDF_TARGET_ESP32

        config BOARD_SQUEEZEAMP_4M
            bool "SqueezeAMP (4MB flash)"
            depends on IDF_TARGET_ESP32

        config BOARD_ESP32S3_GENERIC
            bool "ESP32-S3 Generic"
            depends on IDF_TARGET_ESP32S3

        config BOARD_ESP32_GENERIC
            bool "ESP32 Board with >4M PSRAM"
            depends on IDF_TARGET_ESP32

        config BOARD_ESPARAGUS_AUDIO_BRICK
            bool "Esparagus Audio Brick (ESP32, TAS58xx)"
            depends on IDF_TARGET_ESP32

        config BOARD_ESPARAGUS_AUDIO_BRICK_S3
            bool "Esparagus Audio Brick (ESP32-S3, TAS58xx)"
            depends on IDF_TARGET_ESP32S3

        config BOARD_ESPARAGUS_LOUDER
            bool "Louder Esparagus / Louder-ESP32 (ESP32, TAS58xx)"
            depends on IDF_TARGET_ESP32

        config BOARD_ESPARAGUS_LOUDER_S3
            bool "Louder Esparagus S3 / Louder-ESP32-S3 (ESP32-S3, TAS58xx)"
            depends on IDF_TARGET_ESP32S3

    endchoice

    config BOARD_TARGET_PATH
        string
        default "squeezeamp" if BOARD_SQUEEZEAMP
        default "squeezeamp" if BOARD_SQUEEZEAMP_4M
        default "esp32s3-generic" if BOARD_ESP32S3_GENERIC
        default "esp32-generic" if BOARD_ESP32_GENERIC
        default "esparagus-audio-brick" if BOARD_ESPARAGUS_AUDIO_BRICK
        default "esparagus-audio-brick" if BOARD_ESPARAGUS_AUDIO_BRICK_S3
        default "esparagus-audio-brick" if BOARD_ESPARAGUS_LOUDER
        default "esparagus-audio-brick" if BOARD_ESPARAGUS_LOUDER_S3

    config BOARD_SQUEEZEAMP_COMMON
        bool
        default y if BOARD_SQUEEZEAMP || BOARD_SQUEEZEAMP_4M

    menu "Pin Configuration"
        menu "LED GPIOs"
            config LED_STATUS_GPIO
                int "Status LED GPIO"
                default -1
                help
                    GPIO for status LED (single color). Set to -1 to disable.

            config LED_ERROR_GPIO
                int "Error LED GPIO"
                default -1
                help
                    GPIO for error LED. Set to -1 to disable.

            config LED_RGB_GPIO
                int "RGB LED GPIO (WS2812)"
                default -1
                help
                    GPIO for addressable RGB LED (WS2812). Set to -1 to disable.
        endmenu

        menu "I2S and S/PDIF Pin Configuration"
            config I2S_SCK_IO
                int "I2S Master Clock GPIO"
                default -1
                help
                    I2S Master (system) Clock GPIO pin to use; needed with some I2S conversion boards.
                                        
            config I2S_BCK_IO
                int "I2S Bit Clock GPIO"
                default -1
                help
                    I2S Bit Clock GPIO pin to use.

            config I2S_WS_IO
                int "I2S Word Select GPIO"
                default -1
                help
                    I2S Word Select GPIO pin to use.

            config I2S_DO_IO
                int "I2S Data Output GPIO"
                default -1
                help
                    I2S Data Output GPIO pin to use.

            config SPDIF_DO_IO
                int "SPDIF Data Output GPIO"
                default -1
                help
                    GPIO for SPDIF data output. Set to -1 to disable S/PDIF.

            config I2S_GND_IO
                int "I2S GND GPIO"
                default -1
                help
                    GPIO to provide GND to I2S DAC if powered from GPIO.
                    20mA maximum! Set to -1 to disable.

            config I2S_VCC_IO
                int "I2S VCC GPIO"
                default -1
                help
                    GPIO to provide VCC to I2S DAC if powered from GPIO. 
                    20mA maximum! Set to -1 to disable.
        endmenu

        menu "Control GPIOs"
            config BAT_CHANNEL
                int "Battery Monitor GPIO"
                default -1
                help
                    GPIO for battery voltage monitoring ADC channel. Set to -1 to disable.
                    
            config DAC_I2C_SDA
                int "I2C SDA GPIO for DAC"
                default -1
                help
                    I2C data GPIO pin for DAC control. Set to -1 if not used.

            config DAC_I2C_SCL
                int "I2C SCL GPIO for DAC"
                default -1
                help
                    I2C clock GPIO pin for DAC control. Set to -1 if not used.

            config JACK_GPIO
                int "Headphone Jack Detection GPIO"
                default -1
                help
                    GPIO for headphone jack detection. Set to -1 to disable.

            config SPKFAULT_GPIO
                int "DAC/AMP Fault Detection GPIO"
                default -1
                help
                    GPIO for speaker/amplifier fault detection. Set to -1 to disable.

            config MUTE_GPIO
                int "Mute GPIO"
                default -1
                help
                    GPIO used to mute DAC/amplifier. Set to -1 to disable.

            config MUTE_GPIO_LEVEL
                int "Mute GPIO Active Level"
                default 0
                help
                    Active level for mute GPIO (0=active low, 1=active high).
        endmenu

        menu "SPI and Ethernet Configuration"
            config ETH_W5500_ENABLED
                bool "Enable W5500 SPI Ethernet"
                default n
                help
                    Enable W5500 SPI Ethernet support. Requires SPI bus pins
                    and W5500 chip-select, interrupt and reset GPIOs.

            config SPI_CLK_GPIO
                int "SPI Clock GPIO"
                default 18
                depends on ETH_W5500_ENABLED
                help
                    SPI bus clock GPIO (shared with display).

            config SPI_MOSI_GPIO
                int "SPI MOSI GPIO"
                default 23
                depends on ETH_W5500_ENABLED
                help
                    SPI bus MOSI GPIO (shared with display).

            config SPI_MISO_GPIO
                int "SPI MISO GPIO"
                default 19
                depends on ETH_W5500_ENABLED
                help
                    SPI bus MISO GPIO (shared with display).

            config ETH_W5500_CS_GPIO
                int "W5500 Chip Select GPIO"
                default 5
                depends on ETH_W5500_ENABLED
                help
                    GPIO for W5500 SPI chip select.

            config ETH_W5500_INT_GPIO
                int "W5500 Interrupt GPIO"
                default 35
                depends on ETH_W5500_ENABLED
                help
                    GPIO for W5500 interrupt. Set to -1 to use polling.

            config ETH_W5500_RST_GPIO
                int "W5500 Reset GPIO"
                default 14
                depends on ETH_W5500_ENABLED
                help
                    GPIO for W5500 hardware reset. Set to -1 to disable.

            config ETH_RTL8201_ENABLED
                bool "Enable RTL8201 RMII Ethernet"
                default n
                depends on IDF_TARGET_ESP32 && !ETH_W5500_ENABLED
                help
                    Enable native RMII Ethernet using the RTL8201 PHY.
                    Requires RMII clock, MDC/MDIO, and data pins to be configured.

            config ETH_RTL8201_PHY_ADDR
                int "RTL8201 PHY address"
                default 0
                depends on ETH_RTL8201_ENABLED
                help
                    PHY address for the RTL8201 on the MDIO bus.

            config ETH_RTL8201_RST_GPIO
                int "RTL8201 Reset GPIO"
                default -1
                depends on ETH_RTL8201_ENABLED
                help
                    GPIO for RTL8201 hardware reset. Set to -1 to disable.

            config ETH_RTL8201_MDC_GPIO
                int "RTL8201 MDC GPIO"
                default 23
                depends on ETH_RTL8201_ENABLED
                help
                    GPIO used for the MDIO clock line.

            config ETH_RTL8201_MDIO_GPIO
                int "RTL8201 MDIO GPIO"
                default 18
                depends on ETH_RTL8201_ENABLED
                help
                    GPIO used for the MDIO data line.

            config ETH_RTL8201_RMII_CLK_GPIO
                int "RTL8201 RMII clock GPIO"
                default 0
                depends on ETH_RTL8201_ENABLED
                help
                    GPIO used to receive the external RMII reference clock from the PHY.
                    ESP32 only supports GPIO0 for external RMII clock input.

            config ETH_RTL8201_TX_EN_GPIO
                int "RTL8201 TX_EN GPIO"
                default 21
                depends on ETH_RTL8201_ENABLED
                help
                    GPIO used for RMII TX enable.

            config ETH_RTL8201_TXD0_GPIO
                int "RTL8201 TXD0 GPIO"
                default 19
                depends on ETH_RTL8201_ENABLED
                help
                    GPIO used for RMII TXD0.

            config ETH_RTL8201_TXD1_GPIO
                int "RTL8201 TXD1 GPIO"
                default 22
                depends on ETH_RTL8201_ENABLED
                help
                    GPIO used for RMII TXD1.

            config ETH_RTL8201_CRS_DV_GPIO
                int "RTL8201 CRS_DV GPIO"
                default 17
                depends on ETH_RTL8201_ENABLED
                help
                    GPIO used for RMII CRS_DV.

            config ETH_RTL8201_RXD0_GPIO
                int "RTL8201 RXD0 GPIO"
                default 16
                depends on ETH_RTL8201_ENABLED
                help
                    GPIO used for RMII RXD0.

            config ETH_RTL8201_RXD1_GPIO
                int "RTL8201 RXD1 GPIO"
                default 4
                depends on ETH_RTL8201_ENABLED
                help
                    GPIO used for RMII RXD1.
        endmenu

    endmenu

endmenu
```
